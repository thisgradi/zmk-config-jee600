#include <behaviors.dtsi>
#include <dt-bindings/zmk/keys.h>
#include <dt-bindings/zmk/bt.h>
#include <dt-bindings/zmk/outputs.h>

#include <behaviors/mouse_keys.dtsi>
#include <dt-bindings/zmk/mouse.h>

/ {
	//macros {};
	
	sensors: sensors {
		compatible = "zmk,keymap-sensors";
		sensors = <&encoder_1>;
		triggers-per-rotation = <20>;
	};
	
	keymap {
		compatible = "zmk,keymap";

		/* DEFAULT
		 * ┏━━━━━━━━━┳━━━━━━━━━┓
		 * ┃  LCLK   ┃  RCLK   ┃
		 * ┣━━━━━━━━━╋━━━━━━━━━┫
		 * ┗━━━━━━━━━┻━━━━━━━━━┛
		*/
		
		default_layer {
			bindings = <
				&mkp LCLK		&mkp RCLK
			>;
			sensor-bindings = <&inc_dec_kp C_VOL_UP C_VOL_DN>;
		};
		

		
	};
};